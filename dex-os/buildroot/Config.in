## dex-os/buildroot/defconfig
```kconfig
# ===========================================================================
# DEX OS -- Buildroot Board Defconfig
# ===========================================================================
# Minimal Linux x86_64 system that boots directly into DEX (Electron kiosk).
# Target: bare-metal x86_64 with EFI boot, Mesa GPU, ALSA audio, NetworkManager.
# Build: make BR2_EXTERNAL=../dex-os/buildroot dex_defconfig && make
# ===========================================================================

# ---------------------------------------------------------------------------
# Architecture
# ---------------------------------------------------------------------------
BR2_x86_64=y
BR2_x86_x86_64=y
BR2_x86_64_v3=y

# ---------------------------------------------------------------------------
# Toolchain
# ---------------------------------------------------------------------------
BR2_TOOLCHAIN_BUILDROOT_GLIBC=y
BR2_TOOLCHAIN_BUILDROOT_CXX=y
BR2_KERNEL_HEADERS_6_6=y
BR2_GCC_VERSION_13_X=y
BR2_TOOLCHAIN_BUILDROOT_WCHAR=y
BR2_TOOLCHAIN_BUILDROOT_LOCALE=y

# ---------------------------------------------------------------------------
# Linux kernel
# ---------------------------------------------------------------------------
BR2_LINUX_KERNEL=y
BR2_LINUX_KERNEL_CUSTOM_VERSION=y
BR2_LINUX_KERNEL_CUSTOM_VERSION_VALUE="6.6.30"
BR2_LINUX_KERNEL_USE_DEFCONFIG=y
BR2_LINUX_KERNEL_DEFCONFIG="x86_64"
BR2_LINUX_KERNEL_CONFIG_FRAGMENT_FILES="$(BR2_EXTERNAL_DEX_PATH)/board/dex/kernel.config"
BR2_LINUX_KERNEL_INSTALL_TARGET=y
BR2_LINUX_KERNEL_NEEDS_HOST_OPENSSL=y

# ---------------------------------------------------------------------------
# Init system
# ---------------------------------------------------------------------------
BR2_INIT_SYSTEMD=y
BR2_ROOTFS_MERGED_USR=y

# ---------------------------------------------------------------------------
# Bootloader (GRUB2 for EFI + legacy BIOS)
# ---------------------------------------------------------------------------
BR2_TARGET_GRUB2=y
BR2_TARGET_GRUB2_X86_64_EFI=y
BR2_TARGET_GRUB2_BUILTIN_MODULES_EFI="boot linux ext2 fat part_gpt part_msdos normal efi_gop efi_uga video_bochs video_cirrus"
BR2_TARGET_GRUB2_I386_PC=y
BR2_TARGET_GRUB2_BUILTIN_MODULES_PC="boot linux ext2 fat part_gpt part_msdos normal biosdisk"

# ---------------------------------------------------------------------------
# Filesystem images
# ---------------------------------------------------------------------------
BR2_TARGET_ROOTFS_EXT2=y
BR2_TARGET_ROOTFS_EXT2_4=y
BR2_TARGET_ROOTFS_EXT2_SIZE="2G"
BR2_ROOTFS_POST_BUILD_SCRIPT="$(BR2_EXTERNAL_DEX_PATH)/scripts/post-build.sh"
BR2_ROOTFS_POST_IMAGE_SCRIPT="$(BR2_EXTERNAL_DEX_PATH)/scripts/post-image.sh"
BR2_TARGET_ROOTFS_ISO9660=y
BR2_TARGET_ROOTFS_ISO9660_HYBRID=y

# ---------------------------------------------------------------------------
# GPU / Display (Mesa + Xorg)
# ---------------------------------------------------------------------------
BR2_PACKAGE_MESA3D=y
BR2_PACKAGE_MESA3D_GALLIUM_DRIVER_IRIS=y
BR2_PACKAGE_MESA3D_GALLIUM_DRIVER_RADEONSI=y
BR2_PACKAGE_MESA3D_GALLIUM_DRIVER_NOUVEAU=y
BR2_PACKAGE_MESA3D_GALLIUM_DRIVER_SWRAST=y
BR2_PACKAGE_MESA3D_OPENGL_EGL=y
BR2_PACKAGE_MESA3D_OPENGL_ES=y
BR2_PACKAGE_MESA3D_GBM=y
BR2_PACKAGE_MESA3D_DRI3=y

BR2_PACKAGE_XORG7=y
BR2_PACKAGE_XSERVER_XORG_SERVER=y
BR2_PACKAGE_XSERVER_XORG_SERVER_MODULAR=y
BR2_PACKAGE_XDRIVER_XF86_VIDEO_MODESETTING=y
BR2_PACKAGE_XDRIVER_XF86_INPUT_EVDEV=y
BR2_PACKAGE_XDRIVER_XF86_INPUT_KEYBOARD=y
BR2_PACKAGE_XDRIVER_XF86_INPUT_MOUSE=y
BR2_PACKAGE_XDRIVER_XF86_INPUT_LIBINPUT=y
BR2_PACKAGE_LIBDRM=y

# ---------------------------------------------------------------------------
# Audio (ALSA + PulseAudio)
# ---------------------------------------------------------------------------
BR2_PACKAGE_ALSA_LIB=y
BR2_PACKAGE_ALSA_UTILS=y
BR2_PACKAGE_PULSEAUDIO=y

# ---------------------------------------------------------------------------
# Networking
# ---------------------------------------------------------------------------
BR2_PACKAGE_NETWORK_MANAGER=y
BR2_PACKAGE_NETWORK_MANAGER_WIFI=y
BR2_PACKAGE_WPA_SUPPLICANT=y
BR2_PACKAGE_DHCPCD=y
BR2_PACKAGE_IW=y
BR2_PACKAGE_WIRELESS_TOOLS=y
BR2_PACKAGE_LINUX_FIRMWARE=y
BR2_PACKAGE_LINUX_FIRMWARE_IWLWIFI_8265=y
BR2_PACKAGE_LINUX_FIRMWARE_IWLWIFI_9XXX=y
BR2_PACKAGE_LINUX_FIRMWARE_IWLWIFI_AX200=y
BR2_PACKAGE_LINUX_FIRMWARE_IWLWIFI_AX210=y
BR2_PACKAGE_LINUX_FIRMWARE_MEDIATEK_MT7921=y
BR2_PACKAGE_LINUX_FIRMWARE_REALTEK_RTL8XXXU=y
BR2_PACKAGE_LINUX_FIRMWARE_QUALCOMM_WCN36XX=y

# ---------------------------------------------------------------------------
# Fonts
# ---------------------------------------------------------------------------
BR2_PACKAGE_DEJAVU=y
BR2_PACKAGE_LIBERATION=y
BR2_PACKAGE_FONTCONFIG=y

# ---------------------------------------------------------------------------
# Runtime dependencies for Electron / Chromium
# ---------------------------------------------------------------------------
BR2_PACKAGE_DBUS=y
BR2_PACKAGE_DBUS_GLIB=y
BR2_PACKAGE_LIBGLIB2=y
BR2_PACKAGE_NSPR=y
BR2_PACKAGE_NSS=y
BR2_PACKAGE_CUPS=y
BR2_PACKAGE_AT_SPI2_CORE=y
BR2_PACKAGE_LIBXKBCOMMON=y
BR2_PACKAGE_PANGO=y
BR2_PACKAGE_CAIRO=y
BR2_PACKAGE_GDK_PIXBUF=y
BR2_PACKAGE_GTK3=y
BR2_PACKAGE_LIBNOTIFY=y

# ---------------------------------------------------------------------------
# System utilities
# ---------------------------------------------------------------------------
BR2_PACKAGE_UTIL_LINUX=y
BR2_PACKAGE_E2FSPROGS=y
BR2_PACKAGE_DOSFSTOOLS=y
BR2_PACKAGE_PARTED=y
BR2_PACKAGE_USBUTILS=y
BR2_PACKAGE_PCIUTILS=y
BR2_PACKAGE_KMOD=y

# ---------------------------------------------------------------------------
# Node.js (for native addon rebuild if needed)
# ---------------------------------------------------------------------------
BR2_PACKAGE_NODEJS=y
BR2_PACKAGE_NODEJS_NPM=y

# ---------------------------------------------------------------------------
# DEX package (custom -- see packages/dex/)
# ---------------------------------------------------------------------------
BR2_PACKAGE_DEX=y

# ---------------------------------------------------------------------------
# System configuration
# ---------------------------------------------------------------------------
BR2_TARGET_GENERIC_HOSTNAME="dex"
BR2_TARGET_GENERIC_ISSUE="DEX OS"
BR2_TARGET_GENERIC_ROOT_PASSWD=""
BR2_TARGET_GENERIC_GETTY_PORT="tty1"
BR2_TARGET_GENERIC_GETTY_BAUDRATE_115200=y
BR2_SYSTEM_DEFAULT_PATH="/usr/local/sbin:/usr/local/bin:/usr/sbin:/usr/bin:/sbin:/bin"
BR2_TARGET_TZ_INFO=y
BR2_TARGET_LOCALTIME="UTC"
```

## dex-os/buildroot/packages/dex/Config.in
```kconfig
config BR2_PACKAGE_DEX
	bool "dex"
	depends on BR2_x86_64
	depends on BR2_PACKAGE_XORG7
	depends on BR2_PACKAGE_MESA3D
	depends on BR2_PACKAGE_GTK3
	depends on BR2_PACKAGE_NODEJS
	help
	  DEX desktop environment.
	  Installs the pre-built DEX Electron application and configures
	  the system to boot directly into DEX in kiosk mode.

	  Provides: file management, media processing, creative tools,
	  system monitoring, and the Nexus 3D knowledge graph.

	  https://github.com/onazioj/dex

comment "dex needs X86_64, Xorg, Mesa, GTK3, and Node.js"
	depends on !BR2_x86_64 || !BR2_PACKAGE_XORG7 || !BR2_PACKAGE_MESA3D || !BR2_PACKAGE_GTK3 || !BR2_PACKAGE_NODEJS
```
